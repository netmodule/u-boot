## board/nm/netbird_v2/Kconfig
```kconfig
if TARGET_AM335X_NETBIRD_V2

config SYS_BOARD
        default "netbird_v2"

config SYS_VENDOR
        default "nm"

config SYS_SOC
        default "am33xx"

config SYS_CONFIG_NAME
        default "am335x_netbird_v2"

config CONS_INDEX
        int "UART used for console"
        range 1 6
        default 2
        help
          The AM335x SoC has a total of 6 UARTs (UART0 to UART5 as referenced
          in documentation, etc) available to it.  Depending on your specific
          board you may want something other than UART0 as for example the IDK
          uses UART3 so enter 4 here.

endif
```
